/*
 * CFile1.c
 *
 * Created: 02.11.2016 16:50:57
 *  Author: VAL
 */ 
#include "SiemensA55LCD.h"
#include "Common.h"
#include "Game.h"

#define empty 0
#define ring 1
#define cross 2
	
	
// Menu screen	
const char MenyScreen[] PROGMEM =
{
	255,255,255,127,127,63,31,7,7,7,7,7,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255,
	255,255,255,0,0,0,0,0,0,0,0,0,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255,
	255,255,255,0,0,0,0,0,0,0,4,254,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255,
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	255,255,255,254,254,252,248,224,224,224,224,224,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255
};
	
// Frame
const char Frame[] PROGMEM =
{
	255,255,255,127,127,63,31,7,7,7,7,7,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255,
	255,255,255,0,0,0,0,0,0,0,0,0,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255,
	255,255,255,0,0,0,0,0,0,0,0,0,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255,
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	255,255,255,254,254,252,248,224,224,224,224,224,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255
};

//About screen
const char About[] PROGMEM =
{
	255,255,255,127,127,63,31,7,7,7,7,7,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255,
	255,255,255,0,0,0,0,0,0,0,0,0,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255,
	255,255,255,0,0,0,0,0,0,60,192,0,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255,
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	255,255,255,254,254,252,248,224,224,224,224,224,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255
};
	
const char Figure[3][32] PROGMEM =
{
	{0xFe,0x01,0x01,0x01,0x01,0x01,0x01,0x01,0x01,0x01,0x01,0x01,0x01,0x01,0x01,0xFe,		//Empty
	0x7F,0x80,0x80,0x80,0x80,0x80,0x80,0x80,0x80,0x80,0x80,0x80,0x80,0x80,0x80,0x7F},
	
	{0xFe,0x01,0x0d,0x1D,0x39,0x71,0xe1,0xc1,0xc1,0xe1,0x71,0x39,0x1D,0x0D,0x01,0xFE,		//Cross
	0x7F,0x80,0xB0,0xB8,0x9C,0x8E,0x87,0x83,0x83,0x87,0x8E,0x9C,0xB8,0xB0,0x80,0x7F},
	
	{0xFE,0x01,0xC1,0xF1,0x39,0x19,0x0D,0x0D,0x0D,0x0D,0x19,0x39,0xF1,0xC1,0x01,0xFE,		//Ring
	0x7F,0x80,0x83,0x8F,0x9C,0x98,0xB0,0xB0,0xB0,0xB0,0x98,0x9C,0x8F,0x83,0x80,0x7F}
};

const char PLAYER[] PROGMEM =													//Text Player double
{
	0xFF,0xFF,0x83,0x83,0x83,0x83,0x83,0xFF,0xFF,0x00,0x06,0xFF,0xFF,0x00,
	0x00,0x98,0xD8,0xD8,0xD8,0xD8,0xD8,0xF8,0xF0,0x00,0x00,0xF8,0xF8,0x00,
	0x00,0x00,0x00,0xF8,0xF8,0x00,0xF0,0xF8,0x98,0x98,0x98,0x98,0xF8,0xF0,
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	0x00,0x3F,0x3F,0x00,0x00,0x00,0x00,0x00,0x00
};

const char DRAW[] PROGMEM =
{
	255,255,3,3,3,3,7,254,252,0,0,255,255,195,195,195,195,195,255,126,0,0,240,252,206,199,199,206,252,248,0,0,255,255,128,0,0,0,0,0,0,128,255,255,
	127,127,96,96,96,96,112,63,31,0,0,127,127,0,0,0,1,7,126,120,0,0,127,127,0,0,0,0,127,127,0,0,0,7,31,124,96,28,28,96,124,31,7,0
};

const char WIN[] PROGMEM =
{
	0xFF,0xFF,0x00,0x00,0x00,0x80,0x80,0x00,0x00,0x00,0xFF,0xFF,0x00,0x00,0x03,
	0xFF,0xFF,0x03,0x00,0xFF,0xFF,0xE0,0xC0,0x80,0x00,0x00,0xFF,0xFF,
	0x03,0x0F,0x3E,0x38,0x1E,0x07,0x07,0x1E,0x38,0x3E,0x0F,0x03,0x00,0x00,
	0x30,0x3F,0x3F,0x30,0x00,0x3F,0x3F,0x00,0x01,0x03,0x07,0x0E,0x3F,0x3F
};

const char One[] PROGMEM =
{
	0x00,0x04,0x06,0xFF,0xFF,0x00,0x00,0x00,
	0x00,0x30,0x30,0x3F,0x3F,0x30,0x30,0x00
};

const char Two[] PROGMEM =
{
	0x0C,0x0E,0x07,0x03,0xC3,0xE7,0x7E,0x3C,
	0x3C,0x3E,0x37,0x33,0x31,0x30,0x30,0x30
};

//	Lines combinations
const uint8_t test[8][3] =
{
	{0,1,2},
	{3,4,5},
	{6,7,8},
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	{2,4,6}
};

// Game fielsd
uint8_t game_field[9] = {
	0, 0, 0,
	0, 0, 0,
	0, 0, 0
};

//Game variables	
char MatZeros = 9,Play1 = 0,Play2 = 0; 
bool player1 = true,winnn = false,PvP,fr = false;


void ResetMatrix()
{
	_delay_ms(500);
	for(int8_t i =0; i < 9;i++)
	{
		game_field[i] = 0;
	}
	MatZeros = 9;
	player1 = true;
	fr = false;
}

void WinnerPrint(int result)
{
	fr = false;
	winnn = true;
	TIMSK &=~ (1 << TOIE0);

	LCD_clear();
	LCD_print_screen(&Frame[0]);
	if(result == 0)
	{
		LCD_print_picture(&DRAW[0], 30, 2, 44, 2);
	}
	else 	
	{
		LCD_print_picture(&PLAYER[0], 20, 2, 51, 2);
		if(result == 1)
		{
			LCD_print_picture(&One[0], 80, 2, 8, 2);
			Play1++;
		}
		else
		{
			LCD_print_picture(&Two[0], 80, 2, 8, 2);
			Play2++;
		}
		LCD_print_picture(&WIN[0], 40, 4, 28, 2);
	}
	ResetMatrix();
	_delay_ms(2000);
	LCD_clear();
	TIMSK |= (1 << TOIE0);
}

void Results(int input)
{
	if(input < 5)
	{
		for(uint8_t player = 1; player <= 2; player++)
		for(uint8_t i = 0; i < 8; i++)
		{
			if(game_field[test[i][0]] == player && game_field[test[i][1]] == player && game_field[test[i][2]] == player)
			{
				printer();
				_delay_ms(500);
				WinnerPrint(player);
				break;
			}
		}
		
		if(winnn == true)
		{
			fr = false;
			winnn = false;
			return;
		}
		
		if(input == 0)
		{
			fr = false;
			WinnerPrint(0);
		}
	}
}

void printer()
{
	if(fr == false)
	{
		LCD_print_screen(&Frame[0]);
		fr = true;
	}
	
	for(uint8_t j = 0; j < 9; j++)
	{
		int XX,YY;
		YY = (2*(j/3+1))-1;
		XX = (16*(j%3+1))+33;
	
		LCD_print_picture(&(Figure[game_field[j]][0]), XX, YY, 16, 2);
	}
	
	LCD_Set_Cordinates(5,1);
	LCD_print(48 + Play1/10);
	LCD_print(48 + Play1%10);
	LCD_print(' ');
	LCD_print('-');
	LCD_print(' ');
	LCD_print(48 + Play2/10);
	LCD_print(48 + Play2%10);
	
	if(player1 == true)
	{
		LCD_print_picture(&One[0], 20,3,8,2);
	}
	else
	{
		LCD_print_picture(&Two[0], 20,3,8,2);
	}
}

void Menu()
{
	fr = false;
	LCD_print_screen(&MenyScreen[0]);
	int btn = 0;
	while(1)
	{
		check_matrix(&keyboard);
		btn = get_click(&keyboard);
		
		if(btn == 0)
		{
			PvP = true;
			return;			
		}
		if(btn == 1)
		{
			PvP = false;
			return;		
		}
		if(btn == 2)
		{
			LCD_print_screen(&About[0]);			
			_delay_ms(5000);
			LCD_print_screen(&MenyScreen[0]);
		}
		_delay_ms(15);
	}
}

void ButtonProcessor(int button)
{
if((PvP == false)&(player1 == false))
{
	bool endd = false;
	
	for(uint8_t i = 0; i < 8; i++)
	{
		if((game_field[test[i][0]]==2)&(game_field[test[i][1]]==2)&(game_field[test[i][2]]==0)&(endd == false))
		{
			game_field[test[i][2]] = 2;
			endd = true;
			break;
		}
		if((game_field[test[i][0]]==2)&(game_field[test[i][1]]==0)&(game_field[test[i][2]]==2)&(endd == false))
		{
			game_field[test[i][1]] = 2;
			endd = true;
			break;
		}
		if((game_field[test[i][0]]==0)&(game_field[test[i][1]]==2)&(game_field[test[i][2]]==2)&(endd == false))
		{
			game_field[test[i][0]] = 2;
			endd = true;
			break;
		}
	}
	
	for(uint8_t i = 0; i < 8; i++)
	{
		if((game_field[test[i][0]]==1)&(game_field[test[i][1]]==1)&(game_field[test[i][2]]==0)&(endd == false))
		{
			game_field[test[i][2]] = 2;
			endd = true;
			break;
		}
		if((game_field[test[i][0]]==1)&(game_field[test[i][1]]==0)&(game_field[test[i][2]]==1)&(endd == false))
		{
			game_field[test[i][1]] = 2;
			endd = true;
			break;
		}
		if((game_field[test[i][0]]==0)&(game_field[test[i][1]]==1)&(game_field[test[i][2]]==1)&(endd == false))
		{
			game_field[test[i][0]] = 2;
			endd = true;
			break;
		}
	}
	
	if((game_field[4] == 0)&(endd == false))
	{game_field[4] = 2;
		endd = true;}
		
	if((game_field[0] == 0)&(endd == false))
	{game_field[0] = 2;
		endd = true;}
		
	if((game_field[8] == 0)&(endd == false))
	{game_field[8] = 2;
		endd = true;}
		
	if((game_field[6] == 0)&(endd == false))
	{game_field[6] = 2;
		endd = true;}
		
	if((game_field[3] == 0)&(endd == false))
		{game_field[3] = 2;
		endd = true;}
		
	if((game_field[1] == 0)&(endd == false))
		{game_field[1] = 2;
			endd = true;}
		
	if((game_field[2] == 0)&(endd == false))
		{game_field[2] = 2;
		endd = true;}
		
	if((game_field[5] == 0)&(endd == false))
		{game_field[5] = 2;
		endd = true;}
		
	if((game_field[7] == 0)&(endd == false))
		{game_field[7] = 2;
		endd = true;}
	
		player1 = true;
		MatZeros--;
		Results(MatZeros);
		_delay_ms(500);
	return;
}

if(button == -1) return;


if(player1 == true)
	{
		if(game_field[button] == 0)
		{
			game_field[button] = 1;
			player1 = false;
			MatZeros--;
			Results(MatZeros);
		}			
	}
	if((player1 == false)&(PvP == true))
	{
		if(game_field[button] == 0)
		{
			game_field[button] = 2;
			player1 = true;
			MatZeros--;
			Results(MatZeros);
		}
	}
	else{return;}
}